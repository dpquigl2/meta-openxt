## conf/distro/openxt.conf
```bitbake
DISTRO_NAME = "OpenXT"
DISTRO_VERSION = "1.0alpha1"
DISTRO_FEATURES = "alsa ext2 largefile usbhost wifi xattr pci x11 ipv4 ipv6 ${DISTRO_FEATURES_LIBC} multiarch pam selinux"

########################################################################
# Versioning moved from version file.  This allows changing of version #
# simply by specifying a new distro conf.                              #
########################################################################

# TODO: The versioning is very redundant.  Need to trim down.
XENCLIENT_BUILD = "openxt-dev--master"
XENCLIENT_BUILD_DATE = "18:22:00 09/25/14"
XENCLIENT_BUILD_BRANCH = "master"
XENCLIENT_VERSION = "4.0.0"
XENCLIENT_RELEASE = "4.0.0"
XENCLIENT_TOOLS = "14.0.0.0"

# Identifier for this version of XenClient
RELEASE="4.0.0"

# Marketing-friendly name for this version of XenClient
VERSION="4.0.0"

##########
# NOTE: IMPORTANT - XenClient tools versioning
# This should match the release version with the exception of the Major field
# This field is to be incremented by ten due to historic reasons introduced by xensetup.exe
# i.e. v4 = v14, v5 = v15 and so on...
##########

# Seriously now, the bit above was very important...
# Since we are starting fresh the XC tools version can probably reset
XC_TOOLS_MAJOR="14"
XC_TOOLS_MINOR="0"
XC_TOOLS_MICRO="0"

# Space-separated list of previous releases that can be upgraded from
UPGRADEABLE_RELEASES="3.1.4 3.2.0 3.2.1 3.2.2 3.2.3"

######################################################################
# Java pieces.  Using jamvm-inital causes random crashs using jamvm. #
######################################################################
PREFERRED_PROVIDER_virtual/java-initial = "cacao-initial"
PREFERRED_PROVIDER_virtual/java-native = "jamvm-native"
PREFERRED_PROVIDER_virtual/javac-native = "ecj-bootstrap-native"

##############################################################
# Control what is built in the release.  This is the core of #
# creating the initial release.  It needs to be decided if   #
# recipes will be copied out of OE as they do minor releases #
# or if we will track them.                                  #
##############################################################
PREFERRED_PROVIDER_alsa-utils-alsaconf = "alsa-utils"
PREFERRED_PROVIDER_sysvinit-inittab = "sysvinit"

# Keep the busybox_hwclock sysvinit script out until we use a 
# busybox that contains the feature
MACHINE_FEATURES_BACKFILL_CONSIDERED = "rtc"

PREFERRED_VERSION_busybox = "1.13.2"
PREFERRED_VERSION_consolekit = "0.4.6"
PREFERRED_VERSION_dbus = "1.6.18"
PREFERRED_VERSION_ethtool = "2.6.36"
PREFERRED_VERSION_ghc_native = "6.12.1"
PREFERRED_VERSION_icedtea6-native = "1.8.11"
PREFERRED_VERSION_libsoup-2.4 = "2.45.3"
PREFERRED_VERSION_libtirpc = "0.2.2"
PREFERRED_VERSION_kmod = "16+gitAUTOINC+36c4bb928a"
PREFERRED_VERSION_ocaml-cross = "3.12.1"
PREFERRED_VERSION_openjdk-6-jre = "6b27-1.12.5"
PREFERRED_VERSION_openssh = "6.1p1"
PREFERRED_VERSION_packagegroup-tboot = "0.9"
PREFERRED_VERSION_tpm-tools = "1.3.1"
PREFERRED_VERSION_trousers = "0.3.2-1"

# Stay at eglibc 2.13
PREFERRED_VERSION_eglibc = "2.13"
PREFERRED_VERSION_eglibc-initial = "2.13"
PREFERRED_VERSION_eglibc-locale = "2.13"
PREFERRED_VERSION_cross-localedef-native = "2.13"

# Keep GTK+3 and xfce 4.10 out
PREFERRED_VERSION_evo = "0.6.2"
PREFERRED_VERSION_gtk+ = "2.24.22"
PREFERRED_VERSION_gtk-xfce-engine = "2.9.0"
PREFERRED_VERSION_libxfce4ui = "4.8.1"
PREFERRED_VERSION_libxfce4util = "4.8.2"
PREFERRED_VERSION_midori = "0.1.8"
PREFERRED_VERSION_xfce4 = "4.8.3"
PREFERRED_VERSION_xfce4-panel = "4.8.6"
PREFERRED_VERSION_xfce4-settings = "4.8.3"
PREFERRED_VERSION_xfconf = "4.8.0"
PREFERRED_VERSION_webkit-gtk = "1.8.3"

# Hold back SELinux
PREFERRED_VERSION_checkpoilcy = "2.1.12"
PREFERRED_VERSION_libselinux = "2.1.13"
PREFERRED_VERSION_libsemanage = "2.1.10"
PREFERRED_VERSION_libsepol = "2.1.9"
PREFERRED_VERSION_policycoreutils = "2.1.14"
PREFERRED_VERSION_sepolgen = "1.1.9"
```

## conf/layer.conf
```bitbake
# We have a conf and classes directory, append to BBPATH
BBPATH .= ":${LAYERDIR}"

# meta-selinux tries to sed checkroot.sh which we don't have in initscripts
BBMASK = "meta-selinux/recipes-core/initscripts/"
# meta-selinux changes how the busybox links are handled and affects all versions
BBMASK .= "|meta-selinux/recipes-core/busybox/"
# masking refpolicy until ready to update
BBMASK .= "|meta-selinux/recipes-security/refpolicy/"

# We have a recipes directory, add to BBFILES
BBFILES += "${LAYERDIR}/recipes*/*/*.bb ${LAYERDIR}/recipes*/*/*.bbappend"
BBFILES += "${LAYERDIR}/recipes*/*/*/*.bb ${LAYERDIR}/recipes*/*/*/*.bbappend"

BBFILE_COLLECTIONS += "openxt"
BBFILE_PATTERN_openxt := "^${LAYERDIR}/"
BBFILE_PRIORITY_openxt = "9"

STAGING_IDLDIR = "${STAGING_DATADIR}/idl"

OPENXT_MIRROR="http://openxt.xci-test.com/mirror"
OPENXT_GIT_MIRROR="github.com/OpenXT"
OPENXT_GIT_PROTOCOL="git"
OPENXT_BRANCH="master"
OPENXT_TAG="master"

# xen version and source archive
XEN_VERSION="4.3.3"
XEN_SRC_URI="http://bits.xensource.com/oss-xen/release/4.3.3/xen-4.3.3.tar.gz"
XEN_SRC_MD5SUM="1b4438a50d8875700ac2c7e1ffbcd91b"
XEN_SRC_SHA256SUM="59eb0e1c4a1f66965fe56dcf27cdb5872bf7e0585b7f2e60bd7967ec7f744ebf"

# Proprietary licenses we can ship
LICENSE_FLAGS_WHITELIST = "commercial_broadcom-wifi"
LICENSE_FLAGS_WHITELIST += "commercial_microcode-ctl"
LICENSE_FLAGS_WHITELIST += "Glasgow"

# disable --as-needed flag for the recipes 
ASNEEDED_pn-acpi-helper = ""
ASNEEDED_pn-pci-dm-helper = ""
ASNEEDED_pn-audio-helper = ""
ASNEEDED_pn-atapi-pt-helper = ""
ASNEEDED_pn-ioemu = ""
ASNEEDED_pn-libxcxenstore = ""
ASNEEDED_pn-libsurfman = ""
ASNEEDED_pn-libdmbus = ""
ASNEEDED_pn-vbetool-xc = ""
ASNEEDED_pn-qemu-wrappers = ""
ASNEEDED_pn-pmutil = ""
ASNEEDED_pn-xcpmd = ""
ASNEEDED_pn-tboot = ""
ASNEEDED_pn-selinux-load = ""
ASNEEDED_pn-svirt-interpose = ""
ASNEEDED_pn-xenclient-input-daemon = ""
ASNEEDED_pn-bootage = ""
ASNEEDED_pn-surfman = ""
ASNEEDED_pn-audio-daemon = ""
ASNEEDED_pn-xenclient-sha1sum = ""
ASNEEDED_pn-midori = ""
ASNEEDED_pn-busybox-static = ""
ASNEEDED_pn-dm-agent = ""
ASNEEDED_pn-dm-wrapper = ""
ASNEEDED_pn-dm-wrapper-static = ""
ASNEEDED_pn-xenclient-dbusbouncer = ""
ASNEEDED_pn-sysvinit = ""
#ASNEEDED_pn-xenclient-toolstack = ""
#ASNEEDED_pn-xdotool = ""
#ASNEEDED_pn-uid = ""
ASNEEDED_pn-xenclient-nws = ""

# CFLAGS/LDFLAGS hacks
LDFLAGS_pn-xdotool += "-lX11"
LDFLAGS_pn-midori += "-ljavascriptcoregtk-1.0"

LDFLAGS_pn-compleat += "-pthread"
CFLAGS_pn-compleat += "-pthread"

LDFLAGS_pn-xenclient-rpcgen += "-pthread"
CFLAGS_pn-xenclient-rpcgen += "-pthread"

LDFLAGS_pn-xenclient-input-daemon += "-lm -lcrypto"

LDFLAGS_pn-devilspie += "-lX11"

# Specifying -lrt is necessary until using upstream eglibc
LDFLAGS_pn-xenclient-toolstack += "-lrt"
LDFLAGS_pn-uid += "-lrt"
LDFLAGS_pn-dbd += "-lrt"

CFLAGS_pn-networkmanager-applet += "-Wno-error=unused-but-set-variable"

# make hacks
PARALLEL_MAKE_pn-libxclogging = "-j 1"
PARALLEL_MAKE_pn-gnumail = "-j 1"
PARALLEL_MAKE_pn-gnumail-native = "-j 1"
PARALLEL_MAKE_pn-shared-mime-info = "-j 1"
PARALLEL_MAKE_pn-shared-mime-info-native = "-j 1"

# remainder of old local.conf items
# ocaml
SYSROOT_OCAML_PATH = "${STAGING_DIR_NATIVE}${libdir_native}/${TUNE_PKGARCH}${TARGET_VENDOR}-${TARGET_OS}/ocaml"
OCAML_STDLIBDIR = "${SYSROOT_OCAML_PATH}/site-lib"
OCAML_HEADERS = "${SYSROOT_OCAML_PATH}"
export ocamllibdir = "${libdir}/ocaml"
STAGING_LIBDIR_OCAML = "${STAGING_LIBDIR}/ocaml"
OCAML_FINDLIB_CONF = "${STAGING_DIR_HOST}${sysconfdir}/findlib.conf"

# vhd image format support 
# 100M - safe default, overwrite in the recipe
VHD_MAX_SIZE = "100"
IMAGE_CMD_ext3.vhd = "install -d ${DEPLOY_DIR_IMAGE}/tmp.vhd ; genext2fs -b ${ROOTFS_SIZE} -d ${IMAGE_ROOTFS} ${DEPLOY_DIR_IMAGE}/tmp.vhd/${IMAGE_NAME}.rootfs.ext3 ${EXTRA_IMAGECMD}; tune2fs -j ${DEPLOY_DIR_IMAGE}/tmp.vhd/${IMAGE_NAME}.rootfs.ext3; vhd convert ${DEPLOY_DIR_IMAGE}/tmp.vhd/${IMAGE_NAME}.rootfs.ext3 ${DEPLOY_DIR_IMAGE}/tmp.vhd/${IMAGE_NAME}.rootfs.ext3.vhd ${VHD_MAX_SIZE}; rm -f ${DEPLOY_DIR_IMAGE}/tmp.vhd/${IMAGE_NAME}.rootfs.ext3; mv ${DEPLOY_DIR_IMAGE}/tmp.vhd/${IMAGE_NAME}.rootfs.ext3.vhd ${DEPLOY_DIR_IMAGE}/${IMAGE_NAME}.rootfs.ext3.vhd"
IMAGE_DEPENDS_ext3.vhd = "hs-vhd-native genext2fs-native e2fsprogs-native"

# raw image - simply copy rootfs tree to deploy directory
IMAGE_CMD_raw = "cp -a ${IMAGE_ROOTFS} ${DEPLOY_DIR_IMAGE}/${IMAGE_NAME}.rootfs.raw"

# Normal image size
XC_EXT3_SIZE="327155712"

# Increase image sizes so unstripped packages will fit for debugging
#XC_EXT3_SIZE="800000000"
#XC_EXT3_SIZE_pn-xenclient-uivm-image="1700000000"
#XC_EXT3_SIZE_pn-xenclient-ndvm-image="419430400"
#XC_EXT3_SIZE_pn-xenclient-syncvm-image="209715200"

# Normal build VHD size
XC_EXT3_VHD_SIZE="312"

# Increase VHDs to fit rootfs when doin debugging
#XC_EXT3_VHD_SIZE_pn-xenclient-uivm-image="1624"
#XC_EXT3_VHD_SIZE_pn-xenclient-ndvm-image="400"
#XC_EXT3_VHD_SIZE_pn-xenclient-syncvm-image="200"

XC_EXT3_BVHD_BLOCKS="319488"

IMAGE_CMD_xc.ext3 = "( set -x; I=${DEPLOY_DIR_IMAGE}/${IMAGE_NAME}.rootfs.xc.ext3; truncate -s ${XC_EXT3_SIZE} $I; mke2fs -F -t ext3 $I; tune2fs -c -1 -i 0 $I; gene3fs -i $I -d ${IMAGE_ROOTFS}; e2fsck -f -y $I || true)"
IMAGE_DEPENDS_xc.ext3 = "gene3fs-native e2fsprogs-native"

# sadly the vhd stack in XC doesn't seem to [yet] understand libbudgetvhd's vhds
IMAGE_CMD_xc.ext3.vhd = "( set -x; I=${DEPLOY_DIR_IMAGE}/${IMAGE_NAME}.rootfs.xc.ext3.vhd; truncate -s ${XC_EXT3_SIZE} $I.tmp; mke2fs -F -t ext3 $I.tmp; tune2fs -c -1 -i 0 $I.tmp; gene3fs -i $I.tmp -d ${IMAGE_ROOTFS}; e2fsck -f -y $I.tmp || true ; vhd convert $I.tmp $I ${XC_EXT3_VHD_SIZE} ; rm -f $I.tmp  )"
IMAGE_DEPENDS_xc.ext3.vhd = "hs-vhd-native gene3fs-native e2fsprogs-native"

IMAGE_CMD_xc.ext3.bvhd = "( set -x ; I=${DEPLOY_DIR_IMAGE}/${IMAGE_NAME}.rootfs.xc.ext3.bvhd; bvhd_create $I ${XC_EXT3_BVHD_BLOCKS}; mke2fs -Z -F -t ext3 $I; tune2fs -Z -c -1 -i 0 $I; gene3fs -V -i $I -d ${IMAGE_ROOTFS}; e2fsck -Z -f -y $I || true )"
IMAGE_DEPENDS_xc.ext3.bvhd = "gene3fs-native e2fsprogs-native"

# Build source packages if XENCLIENT_BUILD_SRC_PACKAGES is set to 1.
INHERIT += "openxt-src-package"

# Collect info about sources used in build if XENCLIENT_COLLECT_SRC_INFO is
# set to 1.
INHERIT += "openxt-src-info"


# 2) Build tweaks/hacks

PREFERRED_VERSION_linux-libc-headers = "3.11"
PREFERRED_VERSION_linux-libc-headers-nativesdk = "${PREFERRED_VERSION_linux-libc-headers}"
PREFERRED_VERSION_dojosdk-native = "1.7.2"

PREFERRED_PROVIDER_console-tools = "console-tools"
PREFERRED_PROVIDER_virtual/libx11 = "libx11"

VIRTUAL-RUNTIME_keymaps = "xenclient-console-keymaps"

FILESYSTEM_PERMS_TABLES = "files/xc-fs-perms.txt"
POLKITAUTH = ""
```

## conf/machine/openxt-dom0.conf
```bitbake
# Copyright (C) 2010 Citrix Systems
# Released under the MIT license (see packages/COPYING)
#@TYPE: Machine
#@NAME: openxt-dom0
#@DESCRIPTION: Machine configuration for XenClient dom0 VM

require openxt-common.conf

# set empty provider for initscripts as they are different for installer and dom0
# which share the same machine and require different initscritpts
# therefore for every machine using dom0 arch initscripts have to
# be installed separately
VIRTUAL-RUNTIME_initscripts = ""

# TODO: Change kernel name to openxt
PREFERRED_PROVIDER_virtual/kernel = "linux-openxt-dom0"
PREFERRED_VERSION_linux-openxt-dom0 = "3.11%"
PREFERRED_VERSION_udev = "182"
PREFERRED_PROVIDER_libgl1 = "nvidia-lib"

MACHINE_FEATURES = "kernel26 screen keyboard ethernet pci usbhost acpi ext2 x86"

SERIAL_CONSOLE = "115200 hvc0"
```

## conf/machine/openxt-nilfvm.conf
```bitbake
# Copyright (C) 2010 Citrix Systems
# Released under the MIT license (see packages/COPYING)
#@TYPE: Machine
#@NAME: openxt-nilfvm
#@DESCRIPTION: Machine configuration for XenClient VPN VM

require openxt-common.conf

# TODO: change ndvm package name
# Use ndvm packages when there's no nilfvm version
PACKAGE_EXTRA_ARCHS_tune-core2 += " openxt-nvdm "

# TODO: Change kernel name to openxt
PREFERRED_PROVIDER_virtual/kernel = "linux-openxt-nilfvm"
PREFERRED_VERSION_linux-openxt-nilfvm = "3.11%"
PREFERRED_VERSION_linux-libc-headers = "3.11%"

MACHINE_FEATURES = "kernel26 ethernet pci ext2 x86"

SERIAL_CONSOLE = "38400 xvc0"
```

## conf/machine/openxt-sbuild.conf
```bitbake
# Copyright (C) 2010 Citrix Systems
# Released under the MIT license (see packages/COPYING)
#@TYPE: Machine
#@NAME: openxt-sbuild
#@DESCRIPTION: Machine configuration for XenClient Debian Packet Builder

require openxt-common.conf

# TODO: Change nilfvm name to openxt
PREFERRED_PROVIDER_virtual/kernel = "sbuild-linux"
PREFERRED_VERSION_linux-openxt-nilfvm = "2.6.32"

MACHINE_FEATURES = "kernel26 ethernet pci ext2 x86"

SERIAL_CONSOLE = "38400 xvc0"
```

## conf/machine/openxt-stubdomain.conf
```bitbake
# Copyright (C) 2010 Citrix Systems
# Released under the MIT license (see packages/COPYING)
#@TYPE: Machine
#@NAME: openxt-stubdomain
#@DESCRIPTION: Machine configuration for XenClient stubdomain VM

require openxt-common.conf

# TODO: Change kernel name to openxt
PREFERRED_PROVIDER_virtual/kernel = "linux-openxt-stubdomain"
PREFERRED_VERSION_linux-openxt-stubdomain = "3.11%"

MACHINE_FEATURES = "kernel26 screen keyboard ethernet pci acpi ext2 x86"
```

## conf/machine/openxt-syncvm.conf
```bitbake
require openxt-common.conf

# TODO: Change kernel name to openxt
PREFERRED_PROVIDER_virtual/kernel = "linux-openxt-syncvm"
PREFERRED_VERSION_linux-openxt-syncvm = "3.11%"
PREFERRED_VERSION_udev = "182"

MACHINE_FEATURES = "kernel26 pci acpi ext2 x86"
```

## conf/machine/openxt-uivm.conf
```bitbake
# Copyright (C) 2010 Citrix Systems
# Released under the MIT license (see packages/COPYING)
#@TYPE: Machine
#@NAME: openxt-uivm
#@DESCRIPTION: Machine configuration for XenClient uivm VM

require openxt-common.conf

# TODO: Change kernel name to openxt
PREFERRED_PROVIDER_virtual/kernel = "linux-openxt-uivm"
PREFERRED_VERSION_linux-openxt-uivm = "3.11%"
PREFERRED_VERSION_udev = "182"

PREFERRED_PROVIDER_virtual/xserver = "xserver-xorg"
XSERVER = "xserver-xorg \
           xf86-input-evdev \
           xf86-input-mouse \
           xf86-video-fbdev \
           xf86-input-keyboard"

MACHINE_FEATURES = "kernel26 screen keyboard ethernet pci acpi ext2 x86"
```
